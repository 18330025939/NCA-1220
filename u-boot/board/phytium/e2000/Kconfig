## u-boot/board/phytium/e2000/Kconfig
```kconfig
if TARGET_E2000

config SYS_BOARD
	default "e2000"

config SYS_VENDOR
	default "phytium"

config SYS_CONFIG_NAME
	default "e2000"

endif
```

## u-boot/board/phytium/e2000/fit_kernel_dtb.its
```
/*
 * Compilation:
 * mkimage -f fit_kernel_dtb.its fit_kernel_dtb.itb
 *
 * Files in linux build dir:
 * - arch/arm/boot/Image (zImage-e2000-old-ok)
 * - arch/arm/boot/dts/ft.dtb
 *
 * fatload usb 0:1 0x90100000 fit_kernel_dtb.itb
 * bootm 0x90100000#e2000
 *
 */

/dts-v1/;
/ {
	description = "U-Boot fitImage for Phytium E2000";
	#address-cells = <1>;

	images {
		kernel {
			description = "Linux kernel";
			data = /incbin/("/work1/wcz/E2000/e2000-rc/zImage-e2000-old-ok");
			type = "kernel";
			arch = "arm64";
			os = "linux";
			compression = "none";
			load =  <0x80080000>;
			entry = <0x80080000>;
			hash-1 {
				algo = "sha1";
			};
		};

		fdt-e2000 {
			description = "FDT e2000";
			data = /incbin/("/work1/wcz/E2000/e2000-rc/fip-ftmx/dts/ft.dtb");
			type = "flat_dt";
			arch = "arm64";
			compression = "none";
			hash-1 {
				algo = "sha1";
			};
		};
	};

	configurations {
		default = "e2000";

		dk2 {
			description = "e2000";
			kernel = "kernel";
			fdt = "fdt-e2000";
			hash-1 {
				algo = "sha1";
			};
		};

	};
};
```
